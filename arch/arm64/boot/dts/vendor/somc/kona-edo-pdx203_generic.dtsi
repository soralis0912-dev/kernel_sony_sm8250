/* arch/arm64/boot/dts/vendor/somc/kona-edo-pdx203_generic.dtsi
 *
 * This program is free software; you can redistribute it and/or modify
 * it under the terms of the GNU General Public License version 2 and
 * only version 2 as published by the Free Software Foundation.
 *
 * This program is distributed in the hope that it will be useful,
 * but WITHOUT ANY WARRANTY; without even the implied warranty of
 * MERCHANTABILITY or FITNESS FOR A PARTICULAR PURPOSE.  See the
 * GNU General Public License for more details.
 */

#include "kona-edo-pdx203_common.dtsi"

&soc {
};

#include "somc-edo-display.dtsi"
#include "somc-edo-display-pdx203.dtsi"
/*
 * PN81F (NFC controller with an embedded FeliCa SE) instead of the plain
 * PN557. The extra bits over pn557 are the SPI bus to the eSE, which is only
 * populated on the Japanese models; on the others the SPI probe simply finds
 * nothing behind /dev/p73.
 */
#include "somc-edo-nfc_pn81f.dtsi"
